## firmware/sdkconfig.defaults
```kconfig
CONFIG_IDF_TARGET="esp32c3"
CONFIG_ESPTOOLPY_FLASHSIZE_8MB=y
CONFIG_ESPTOOLPY_HEADER_FLASHSIZE_UPDATE=n
CONFIG_PARTITION_TABLE_CUSTOM=y
CONFIG_PARTITION_TABLE_CUSTOM_FILENAME="partitions.csv"
CONFIG_PARTITION_TABLE_FILENAME="partitions.csv"
CONFIG_ESP_CONSOLE_USB_SERIAL_JTAG=y
CONFIG_ESP_CONSOLE_SECONDARY_NONE=y
CONFIG_ESP_CONSOLE_USB_SERIAL_JTAG_ENABLED=y
CONFIG_LOG_DEFAULT_LEVEL_NONE=y
CONFIG_BOOTLOADER_LOG_LEVEL_NONE=y
CONFIG_LV_COLOR_DEPTH_16=y
CONFIG_LV_DEF_REFR_PERIOD=40
CONFIG_LV_FONT_MONTSERRAT_14=y
CONFIG_LV_USE_CLIB_MALLOC=y
CONFIG_FREERTOS_HZ=1000
CONFIG_BT_ENABLED=n
CONFIG_ESP_MAIN_TASK_STACK_SIZE=12288
CONFIG_ESP_WIFI_STATIC_RX_BUFFER_NUM=4
CONFIG_ESP_WIFI_DYNAMIC_RX_BUFFER_NUM=8
CONFIG_ESP_WIFI_DYNAMIC_TX_BUFFER_NUM=8
CONFIG_ESP_WIFI_NVS_ENABLED=n
CONFIG_LWIP_MAX_SOCKETS=6
CONFIG_MBEDTLS_HARDWARE_SHA=y
CONFIG_COMPILER_OPTIMIZATION_SIZE=y
```
